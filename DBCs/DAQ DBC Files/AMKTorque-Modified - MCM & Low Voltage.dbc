VERSION "HIPBNYYYYYYYYYYYYYYYYYYYYYYYYYYYYYYYYYYYYY/4/%%%/4/'%**4YYY///"

NS_ :

BS_:

BU_: DBG VCU BMS MCM DCU DAQ S2C

BO_ 1287 Low_Voltage: 8 DAQ
 SG_ Voltage : 0|16@1+ (0.001,0) [0|20] "V" VCU

BO_ 1289 MCM_RTD_HVIL: 8 VCU
 SG_ HVIL_Active : 0|16@1+ (1,0) [0|20] "" VCU

BO_ 1794 MCM_RegenModeICSent: 8 MCM
   SG_ RegenMode : 0|3@1+ (1,0) [0|3] "Regen mode" MCM
