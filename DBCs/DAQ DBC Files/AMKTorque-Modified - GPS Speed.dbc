VERSION "HIPBNYYYYYYYYYYYYYYYYYYYYYYYYYYYYYYYYYYYYY/4/%%%/4/'%**4YYY///"

NS_ :

BS_:

BU_: DBG VCU BMS MCM DCU DAQ S2C

BO_ 1025 GPS_Speed: 8 Aceinna
 SG_ Speed : 0|16@1- (0.001,0) [-1000|1000] "kph" Vector__XXX
